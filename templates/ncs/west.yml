## templates/ncs/west.yml
```yaml
manifest:
  remotes:
    - name: nrfconnect
      url-base: https://github.com/nrfconnect
  projects:
    - name: nrf
      repo-path: sdk-nrf
      remote: nrfconnect
      revision: v3.0.1
      import:
        name-blocklist:
          - matter
          - nrf-802154
          - cjson
          - openthread
          - cmock
          - unity
          - cddl-gen
          - homekit
          - loramac-node
          - lz4
          - lvgl
          - mipi-sys-t
  self:
    # This repository should be cloned to
    path: app
```

## templates/nfed/west.yml
```yaml
manifest:
  projects:
    - name: nfed
      url: https://github.com/circuitdojo/nrf9160-feather-examples-and-drivers.git
      path: nfed
      revision: v3.0.x
      import: true
  self:
    # This repository should be cloned to
    path: app
```

## templates/vanilla/west.yml
```yaml
manifest:
  remotes:
    - name: zephyrproject
      url-base: https://github.com/zephyrproject-rtos
  projects:
    - name: zephyr
      repo-path: zephyr
      remote: zephyrproject
      revision: v4.2.0
      import: true
  self:
    # This repository should be cloned to
    path: app
```
