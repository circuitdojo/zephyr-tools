&i2c2 {
	npm1300_pmic: pmic@6b {
		compatible = "nordic,npm1300";
		reg = <0x6b>;

		npm1300_leds: leds {
			compatible = "nordic,npm1300-led";
			nordic,led0-mode = "host";
			nordic,led1-mode = "host";
			nordic,led2-mode = "host";
		};
	};
};